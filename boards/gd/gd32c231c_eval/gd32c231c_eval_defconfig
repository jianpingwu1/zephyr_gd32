## boards/gd/gd32c231c_eval/gd32c231c_eval_defconfig
```kconfig
# Copyright (c) 2025, GigaDevice Semiconductor Inc.
# SPDX-License-Identifier: Apache-2.0

# CONFIG_SOC_SERIES_GD32C2X1=y
# CONFIG_SOC_GD32C231C8=y

CONFIG_CONSOLE=y
CONFIG_SERIAL=y
CONFIG_UART_CONSOLE=y

CONFIG_GPIO=y

CONFIG_PINCTRL=y
```
